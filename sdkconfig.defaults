## sdkconfig.defaults
```kconfig
# ── Target: M5Cardputer = ESP32-S3 (StampS3, 8MB flash, NO PSRAM) ──
CONFIG_IDF_TARGET="esp32s3"

CONFIG_ESPTOOLPY_FLASHSIZE_8MB=y

# Custom layout: 1MB app + 6.9MB "romdata" partition that caches the first
# 222 ROM banks in internal flash (mmapped, direct-read). See partitions.csv.
CONFIG_PARTITION_TABLE_CUSTOM=y
CONFIG_PARTITION_TABLE_CUSTOM_FILENAME="partitions.csv"

# ── FreeRTOS / main task ──
CONFIG_FREERTOS_HZ=1000
CONFIG_ESP_MAIN_TASK_STACK_SIZE=32768

# ── FATFS (SD card, UTF-8 + GBK for 文曲星 filenames) ──
CONFIG_FATFS_LFN_HEAP=y
CONFIG_FATFS_MAX_LFN=255
CONFIG_FATFS_CODEPAGE_936=y
CONFIG_FATFS_API_ENCODING_UTF_8=y

# ── Optimizations ──
CONFIG_ESP_DEFAULT_CPU_FREQ_MHZ_240=y
CONFIG_ESPTOOLPY_FLASHMODE_QIO=y
CONFIG_COMPILER_OPTIMIZATION_PERF=y
CONFIG_COMPILER_OPTIMIZATION_ASSERTIONS_DISABLE=y
CONFIG_ESP_ERR_TO_NAME_LOOKUP=n
```
